## boards/arm/nice_nano/Kconfig.board
```kconfig
config BOARD_NICE_NANO
	bool "nice!nano (compatible)"
	depends on SOC_NRF52840_QIAA
```

## boards/arm/nice_nano/Kconfig.defconfig
```kconfig
if BOARD_NICE_NANO

config BOARD
	default "nice_nano"

config BT_CTLR
	default BT

endif # BOARD_NICE_NANO
```
